## buildroot-external/Config.in
```kconfig
menu "Mira packages"
	source "$BR2_EXTERNAL_MIRA_PATH/package/sd-event-shim/Config.in"
	source "$BR2_EXTERNAL_MIRA_PATH/package/mirad/Config.in"
	source "$BR2_EXTERNAL_MIRA_PATH/package/flutter-engine-bin/Config.in"
	source "$BR2_EXTERNAL_MIRA_PATH/package/flutterpi/Config.in"
	source "$BR2_EXTERNAL_MIRA_PATH/package/mira-shell/Config.in"
	source "$BR2_EXTERNAL_MIRA_PATH/package/mira-inputd/Config.in"
	source "$BR2_EXTERNAL_MIRA_PATH/package/netbird/Config.in"
endmenu
```

## buildroot-external/package/flutterpi/Config.in
```kconfig
config BR2_PACKAGE_FLUTTERPI
	bool "flutterpi (Mira build)"
	depends on BR2_PACKAGE_FLUTTER_ENGINE_BIN_ARCH_SUPPORTS
	depends on BR2_TOOLCHAIN_HAS_THREADS
	depends on BR2_TOOLCHAIN_USES_GLIBC
	depends on !BR2_STATIC_LIBS
	depends on BR2_PACKAGE_HAS_LIBGLES
	depends on BR2_PACKAGE_HAS_LIBGBM
	depends on BR2_PACKAGE_HAS_UDEV
	select BR2_PACKAGE_FLUTTER_ENGINE_BIN
	select BR2_PACKAGE_SD_EVENT_SHIM
	select BR2_PACKAGE_LIBDRM
	select BR2_PACKAGE_LIBINPUT
	select BR2_PACKAGE_LIBXKBCOMMON
	select BR2_PACKAGE_GSTREAMER1 # video player plugin
	select BR2_PACKAGE_GST1_PLUGINS_BASE
	select BR2_PACKAGE_GST1_PLUGINS_BASE_PLUGIN_APP # appsink
	help
	  flutter-pi, the Flutter embedder that renders straight to
	  DRM/KMS with no X11 and no Wayland.

	  Mira builds it separately from Buildroot's flutter-pi package
	  because that one depends on BR2_PACKAGE_SYSTEMD, which in
	  Buildroot can only be enabled when systemd is also init. Mira
	  uses BusyBox init and supplies sd-event itself - see
	  sd-event-shim.

comment "flutterpi needs OpenGL ES, GBM, udev and a glibc toolchain w/ threads"
	depends on BR2_PACKAGE_FLUTTER_ENGINE_BIN_ARCH_SUPPORTS
	depends on !BR2_PACKAGE_HAS_LIBGLES || !BR2_PACKAGE_HAS_LIBGBM \
		|| !BR2_PACKAGE_HAS_UDEV || !BR2_TOOLCHAIN_HAS_THREADS \
		|| !BR2_TOOLCHAIN_USES_GLIBC || BR2_STATIC_LIBS
```

## buildroot-external/package/mira-inputd/Config.in
```kconfig
config BR2_PACKAGE_MIRA_INPUTD
	bool "mira-inputd"
	help
	  HDMI-CEC to uinput bridge, so TV remote keys arrive as ordinary input events.

	  Not yet implemented - placeholder so the Mira menu resolves.
```

## buildroot-external/package/mira-shell/Config.in
```kconfig
config BR2_PACKAGE_MIRA_SHELL
	bool "mira-shell"
	depends on BR2_PACKAGE_FLUTTERPI
	help
	  Mira Shell - the Flutter launcher, as a flutter-pi asset bundle.

	  Build the bundle first with ./scripts/build-shell.sh; this
	  package installs it and the launcher that mirad supervises.

comment "mira-shell needs flutterpi"
	depends on !BR2_PACKAGE_FLUTTERPI
```

## buildroot-external/package/mirad/Config.in
```kconfig
config BR2_PACKAGE_MIRAD
	bool "mirad"
	help
	  Mira system supervisor. Prepares persistent state and
	  supervises mira-shell, restarting it with backoff if it dies.

	  This is the process init hands the box off to.
```

## buildroot-external/package/netbird/Config.in
```kconfig
config BR2_PACKAGE_NETBIRD
	bool "netbird"
	depends on BR2_PACKAGE_HOST_GO_TARGET_ARCH_SUPPORTS
	select BR2_PACKAGE_HOST_GO
	help
	  NetBird mesh VPN client (CLI + daemon), used to reach the home
	  server. Client only: no management, signal, relay or UI.

	  Uses kernel WireGuard; the package enables TUN, WireGuard,
	  nftables and policy routing in the kernel config.

	  https://github.com/netbirdio/netbird

comment "netbird needs a toolchain w/ Go support"
	depends on !BR2_PACKAGE_HOST_GO_TARGET_ARCH_SUPPORTS
```

## buildroot-external/package/sd-event-shim/Config.in
```kconfig
config BR2_PACKAGE_SD_EVENT_SHIM
	bool "sd-event-shim"
	depends on BR2_TOOLCHAIN_HAS_THREADS
	help
	  Mira's own implementation of the sd-event subset that
	  flutter-pi needs, installed as libsystemd.

	  flutter-pi requires libsystemd, but Buildroot only builds
	  systemd when systemd is also init - and Mira is a BusyBox-init
	  appliance that boots in two seconds. flutter-pi uses sd-event
	  in 103 places and sd-bus in none, so Mira supplies the event
	  loop rather than adopting systemd or carrying a large patch.

	  This is not systemd and provides nothing but sd-event.

comment "sd-event-shim needs a toolchain w/ threads"
	depends on !BR2_TOOLCHAIN_HAS_THREADS
```
